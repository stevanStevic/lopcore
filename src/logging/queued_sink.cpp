/**
 * @file queued_sink.cpp
 * @brief Implementation of the asynchronous (queued) log sink decorator
 *
 * @copyright Copyright (c) 2026 LopCore Contributors
 * @license MIT License
 */

#include "lopcore/logging/queued_sink.hpp"

#include <utility>

namespace lopcore
{

namespace
{
// Set while the current thread is forwarding messages to the inner sink.
// Log lines generated by the inner sink's own I/O (e.g. the MQTT client
// logging its publish) would otherwise re-enqueue 1:1 and never let the
// queue empty.
thread_local bool t_draining = false;
} // namespace

QueuedSink::QueuedSink(std::unique_ptr<ILogSink> inner, QueuedSinkConfig config)
    : inner_(std::move(inner)), config_(config)
{
    taskStoppedSemaphore_ = xSemaphoreCreateBinary();
}

QueuedSink::~QueuedSink()
{
    stopDrainTask();
    if (taskStoppedSemaphore_ != nullptr)
    {
        vSemaphoreDelete(taskStoppedSemaphore_);
        taskStoppedSemaphore_ = nullptr;
    }
    // Remaining queued messages are dropped by design: draining here could
    // publish through subsystems that are already torn down.
}

void QueuedSink::write(const LogMessage &msg)
{
    std::lock_guard<std::mutex> lock(queueMutex_);

    if (t_draining)
    {
        droppedCount_++;
        return;
    }

    if (queue_.size() >= config_.maxQueuedMessages)
    {
        queue_.pop_front();
        droppedCount_++;
    }

    OwnedLogMessage owned;
    owned.level = msg.level;
    owned.timestamp_ms = msg.timestamp_ms;
    owned.tag = (msg.tag != nullptr) ? msg.tag : "";
    owned.message = (msg.message != nullptr) ? msg.message : "";
    queue_.push_back(std::move(owned));
}

void QueuedSink::flush()
{
    // Intentionally empty - see header. Use poll() to drain.
}

const char *QueuedSink::getName() const
{
    return "QueuedSink";
}

size_t QueuedSink::poll(size_t maxMessages)
{
    size_t forwarded = 0;

    while (forwarded < maxMessages)
    {
        OwnedLogMessage owned;
        {
            std::lock_guard<std::mutex> lock(queueMutex_);
            if (queue_.empty())
            {
                break;
            }
            owned = std::move(queue_.front());
            queue_.pop_front();
        }

        // Reconstruct a LogMessage pointing at the owned strings. The inner
        // sink runs with NO lock of ours held except the thread_local guard.
        LogMessage msg;
        msg.level = owned.level;
        msg.timestamp_ms = owned.timestamp_ms;
        msg.tag = owned.tag.c_str();
        msg.message = owned.message.c_str();
        msg.file = nullptr;
        msg.line = 0;

        t_draining = true;
        inner_->write(msg);
        t_draining = false;

        forwarded++;
    }

    return forwarded;
}

uint32_t QueuedSink::droppedCount() const
{
    std::lock_guard<std::mutex> lock(queueMutex_);
    return droppedCount_;
}

esp_err_t QueuedSink::startDrainTask()
{
    if (drainTask_ != nullptr)
    {
        return ESP_ERR_INVALID_STATE;
    }

    // Drain a stale "stopped" signal from a previous task instance
    xSemaphoreTake(taskStoppedSemaphore_, 0);

    shouldRun_ = true;
    BaseType_t result = xTaskCreate(drainTaskWrapper, "log_drain", config_.taskStackSize, this,
                                    config_.taskPriority, &drainTask_);
    if (result != pdPASS)
    {
        shouldRun_ = false;
        drainTask_ = nullptr;
        return ESP_FAIL;
    }

    return ESP_OK;
}

void QueuedSink::stopDrainTask()
{
    if (drainTask_ == nullptr)
    {
        return;
    }

    shouldRun_ = false;

    const TickType_t maxWaitTicks = pdMS_TO_TICKS(2 * config_.drainPeriodMs + 500);
    if (xSemaphoreTake(taskStoppedSemaphore_, maxWaitTicks) != pdTRUE)
    {
        vTaskDelete(drainTask_);
    }
    drainTask_ = nullptr;
}

void QueuedSink::drainTaskWrapper(void *pvParameters)
{
    QueuedSink *sink = static_cast<QueuedSink *>(pvParameters);
    if (sink)
    {
        sink->drainTask();
    }
}

void QueuedSink::drainTask()
{
    while (shouldRun_)
    {
        poll(config_.maxBatchPerDrain);

        // Sleep in 10 ms chunks so stopDrainTask() is honored promptly
        for (uint32_t i = 0; i < config_.drainPeriodMs && shouldRun_; i += 10)
        {
            vTaskDelay(pdMS_TO_TICKS(10));
        }
    }

    xSemaphoreGive(taskStoppedSemaphore_);
    vTaskDelete(nullptr);
}

} // namespace lopcore
